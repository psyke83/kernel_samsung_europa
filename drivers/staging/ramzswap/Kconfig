## drivers/staging/ramzswap/Kconfig
```kconfig
config RAMZSWAP
	tristate "Compressed swap (ramzswap) support"
	depends on SWAP && CRYPTO_LZO && !ZRAM
	default n
	---help---
	  This will build the compressed swap (ramzswap) module
```
